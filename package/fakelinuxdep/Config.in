## package/fakelinuxdep/Config.in
```kconfig
config BR2_PACKAGE_FAKELINUXDEP
        bool "fakelinuxdep"
        help
          A dirty workaround
```

## package/librina/Config.in
```kconfig
config BR2_PACKAGE_LIBRINA
        bool "librina"
        select BR2_PACKAGE_FAKELINUXDEP
        help
          The librina package is part of the IRATI stack.

          https://github.com/irati/stack
```

## package/openjdk/Config.in
```kconfig
config BR2_PACKAGE_OPENJDK
        bool "openjdk"
        select BR2_PACKAGE_FREETYPE
        help
          The openjdk version 8.
```

## package/rina-tgen/Config.in
```kconfig
config BR2_PACKAGE_RINA_TGEN
        bool "rina-tgen"
        select BR2_PACKAGE_LIBRINA
        help
          The rina-tools package is part of the IRATI stack.

          https://github.com/irati/stack
```

## package/rina-tools/Config.in
```kconfig
config BR2_PACKAGE_RINA_TOOLS
        bool "rina-tools"
        select BR2_PACKAGE_RINAD BR2_PACKAGE_LIBRINA
        help
          The rina-tools package is part of the IRATI stack.

          https://github.com/irati/stack
```

## package/rinad-plugins/Config.in
```kconfig
config BR2_PACKAGE_RINAD_PLUGINS
        bool "rinad-plugins"
        select BR2_PACKAGE_RINAD
        help
          The rinad package is part of the IRATI stack.

          https://github.com/irati/stack
```

## package/rinad/Config.in
```kconfig
config BR2_PACKAGE_RINAD
        bool "rinad"
        select BR2_PACKAGE_LIBRINA
        help
          The rinad package is part of the IRATI stack.

          https://github.com/irati/stack
```
